## IOTGatewayBuildEnv/conf/bblayers.conf
```bitbake
# POKY_BBLAYERS_CONF_VERSION is increased each time build/conf/bblayers.conf
# changes incompatibly
POKY_BBLAYERS_CONF_VERSION = "2"

BBPATH = "${TOPDIR}"
BBFILES ?= ""

BBLAYERS ?= " \
  /home/IbrahimSaber/YoctoTraining/poky/meta \
  /home/IbrahimSaber/YoctoTraining/poky/meta-poky \
  /home/IbrahimSaber/YoctoTraining/poky/meta-yocto-bsp \
  /home/IbrahimSaber/YoctoTraining/poky/meta-openembedded/meta-oe \
  /home/IbrahimSaber/YoctoTraining/poky/meta-qt5 \
  /home/IbrahimSaber/YoctoTraining/poky/meta-openembedded/meta-python \
  /home/IbrahimSaber/YoctoTraining/poky/meta-iotgateway \
  /home/IbrahimSaber/YoctoTraining/poky/meta-iotgateway-distro \
  /home/IbrahimSaber/YoctoTraining/poky/meta-openembedded/meta-networking \
  /home/IbrahimSaber/YoctoTraining/poky/meta-openembedded/meta-multimedia \
  /home/IbrahimSaber/YoctoTraining/poky/meta-raspberrypi \
  "
```

## meta-iotgateway-distro/conf/distro/include/systemd.inc
```bitbake
# install systemd init manager
DISTRO_FEATURES:append =" systemd "

#add systemd as init manager

VIRTUAL-RUNTIME_init_manager = "systemd"

VIRTUAL-RUNTIME_initscripts = "systemd-compat-units"
```

## meta-iotgateway-distro/conf/distro/iotgateway-distro.conf
```bitbake
SUMMARY = "Distribution recipe for the IOTgateWay project"
DESCRIPTION = ""
# Distibution Information.
DISTRO="iotgateway-distro"
DISTRO_NAME="IOTgateWay"
DISTRO_VERSION="1.0"
MAINTAINER = "ibrahimsaber249@gmail.com"

# SDK Information.
SDK_VENDOR = "-bulletSDK"
SDK_VERSION = "${@d.getVar('DISTRO_VERSION').replace('snapshot-${METADATA_REVISION}', 'snapshot')}"
SDK_VERSION[vardepvalue] = "${SDK_VERSION}"

SDK_NAME = "${DISTRO}-${TCLIBC}-${SDKMACHINE}-${IMAGE_BASENAME}-${TUNE_PKGARCH}-${MACHINE}"
# Installation path --> can be changed to ${HOME}-${DISTRO}-${SDK_VERSION}
SDKPATHINSTALL = "/opt/${DISTRO}/${SDK_VERSION}" 


# IOTGATEWAY --> IOTGATEWAY
#SATISFY REQ[3.4]
IOTGATEWAY_DEFAULT_DISTRO_FEATURES = "largefile opengl ptest multiarch vulkan x11 wifi qt5 aduio wayland vulkan"
IOTGATEWAY_DEFAULT_EXTRA_RDEPENDS = "packagegroup-core-boot"
IOTGATEWAY_DEFAULT_EXTRA_RRECOMMENDS = "kernel-module-af-packet"

DISTRO_FEATURES ?= "${DISTRO_FEATURES_DEFAULT} ${IOTGATEWAY_DEFAULT_DISTRO_FEATURES} userland"

#SATISFY REQ[3.1]
require conf/distro/include/systemd.inc

# Pulseaudio is required to stream audio over Bluetooth
DISTRO_FEATURES:append = " pulseaudio"
# Integrate Bluetooth
DISTRO_FEATURES:append = " pi-bluetooth bluez5 bluetooth linux-firmware-bcm43430 linux-firmware-brcmfmac43430"


#SATISFY REQ[3.0]
# prefered version for packages.
PREFERRED_VERSION_linux-yocto ?= "5.15%"
PREFERRED_VERSION_linux-yocto-rt ?= "5.15%"


# Build System configuration.

LOCALCONF_VERSION="2"

# add poky sanity bbclass
INHERIT += "poky-sanity"
```

## meta-iotgateway-distro/conf/layer.conf
```bitbake
# We have a conf and classes directory, add to BBPATH
BBPATH .= ":${LAYERDIR}"

# We have recipes-* directories, add to BBFILES
BBFILES += "${LAYERDIR}/recipes-*/*/*.bb \
            ${LAYERDIR}/recipes-*/*/*.bbappend"

BBFILE_COLLECTIONS += "meta-iotgateway-distro"
BBFILE_PATTERN_meta-iotgateway-distro = "^${LAYERDIR}/"
BBFILE_PRIORITY_meta-iotgateway-distro = "6"

LAYERDEPENDS_meta-iotgateway-distro = "core"
LAYERSERIES_COMPAT_meta-iotgateway-distro = "kirkstone"
```
